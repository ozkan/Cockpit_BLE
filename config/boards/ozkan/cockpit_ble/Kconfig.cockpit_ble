## config/boards/ozkan/cockpit_ble/Kconfig.cockpit_ble
```kconfig
# cockpit_ble board configuration

# Copyright (c) 2023 ozkan (github.com/ozkan)
# SPDX-License-Identifier: MIT

config BOARD_COCKPIT_BLE
    select SOC_NRF52840_QIAA
    select ZMK_BOARD_COMPAT
    imply RETAINED_MEM
    imply RETENTION
    imply RETENTION_BOOT_MODE
```

## config/boards/ozkan/cockpit_ble/board.yml
```yaml
board:
  name: cockpit_ble
  vendor: ozkan
  socs:
    - name: nrf52840
      variants:
        - name: zmk
```

## config/boards/ozkan/cockpit_ble/cockpit_ble_nrf52840_zmk_defconfig
```kconfig
# Enable MPU
CONFIG_ARM_MPU=y

# Enable GPIO
CONFIG_GPIO=y

# Flash and settings
CONFIG_USE_DT_CODE_PARTITION=y
CONFIG_MPU_ALLOW_FLASH_WRITE=y
CONFIG_BUILD_OUTPUT_UF2=y
CONFIG_NVS=y
CONFIG_SETTINGS_NVS=y
CONFIG_FLASH=y
CONFIG_FLASH_PAGE_LAYOUT=y
CONFIG_FLASH_MAP=y

# Enable PINCTRL
CONFIG_PINCTRL_NRF=y
CONFIG_PINCTRL=y

# Rotary encoder
CONFIG_EC11=y
CONFIG_EC11_TRIGGER_GLOBAL_THREAD=y

# External power
CONFIG_ZMK_EXT_POWER=y

# 32kHz crystal
CONFIG_CLOCK_CONTROL_NRF_K32SRC_XTAL=y
CONFIG_CLOCK_CONTROL_NRF_K32SRC_30PPM=y

# Bluetooth GATT
CONFIG_BT_GATT_ENFORCE_SUBSCRIPTION=n
```
